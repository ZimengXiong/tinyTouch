## firmware/tiny_touch_smartcard/sdkconfig.defaults
```kconfig
CONFIG_IDF_TARGET="esp32s3"
CONFIG_TINYUSB=y
CONFIG_TINYUSB_DESC_USE_DEFAULT_PID=n
CONFIG_TINYUSB_DESC_CUSTOM_PID=0x4001
CONFIG_TINYUSB_DESC_MANUFACTURER_STRING="tinyTouch"
CONFIG_TINYUSB_DESC_PRODUCT_STRING="tinyTouch PIV"
CONFIG_TINYUSB_DESC_SERIAL_STRING="TT-PIV-PROTOTYPE"
CONFIG_TINYUSB_HID_COUNT=1
CONFIG_ESP_CONSOLE_USB_SERIAL_JTAG=y
```
